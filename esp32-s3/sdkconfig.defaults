## esp32-s3/sdkconfig.defaults
```kconfig
# 目标芯片
CONFIG_IDF_TARGET="esp32s3"

# USB Host 全速
CONFIG_USB_HOST_ENABLED=y
CONFIG_USB_HOST_HID_BUF_SIZE=256

# SPI Master
CONFIG_SPI_MASTER_IN_IRAM=y

# FreeRTOS
CONFIG_FREERTOS_HZ=1000

# 串口输出（USB Serial/JTAG 或 UART0）
CONFIG_ESP_CONSOLE_USB_SERIAL_JTAG=y
```
